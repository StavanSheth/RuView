## firmware/esp32-csi-node/sdkconfig.defaults.esp32
```kconfig
# ESP32 Generic CSI Node — 4MB Flash SDK Configuration
# For boards like DOIT ESP32 DevKit V3.

CONFIG_IDF_TARGET="esp32"

# 4MB flash partition table
CONFIG_PARTITION_TABLE_CUSTOM=y
CONFIG_PARTITION_TABLE_CUSTOM_FILENAME="partitions_4mb.csv"
CONFIG_ESPTOOLPY_FLASHSIZE_4MB=y
CONFIG_ESPTOOLPY_FLASHSIZE="4MB"

# Compiler: optimize for size
CONFIG_COMPILER_OPTIMIZATION_SIZE=y

# CSI support
CONFIG_ESP_WIFI_CSI_ENABLED=y

# Disable display support (saves flash/RAM on generic ESP32)
# CONFIG_DISPLAY_ENABLE is not set

# Reduce logging
CONFIG_BOOTLOADER_LOG_LEVEL_WARN=y
CONFIG_LOG_DEFAULT_LEVEL_INFO=y

CONFIG_LWIP_SO_RCVBUF=y
CONFIG_ESP_MAIN_TASK_STACK_SIZE=8192
```
